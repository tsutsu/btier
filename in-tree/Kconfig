## in-tree/Kconfig
```kconfig
#
# btier
#

config BTIER
	tristate "Enable btier"
	default m
	select CRYPTO_TGR192
	---help---
	btier allows to create a tiered blockdevice from
	multiple redundant blockdevices.

	If unsure, say N.
```
